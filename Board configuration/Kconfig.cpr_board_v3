## Board configuration/cpr_board_v3_defconfig
```kconfig
#General configuration
CONFIG_ARM_MPU=y
CONFIG_HW_STACK_PROTECTION=y
CONFIG_GPIO=y
CONFIG_SERIAL=y
CONFIG_PINCTRL=y

#Logging configuration
CONFIG_LOG=y
CONFIG_USE_SEGGER_RTT=y
CONFIG_LOG_BACKEND_RTT=y
CONFIG_LOG_BACKEND_UART=n
CONFIG_LOG_DEFAULT_LEVEL=3

# Mode de log recomanat
CONFIG_LOG_MODE_DEFERRED=y
CONFIG_LOG_RUNTIME_FILTERING=y
CONFIG_LOG_BUFFER_SIZE=2048
CONFIG_LOG_PRINTK=y
CONFIG_LOG_PROCESS_TRIGGER_THRESHOLD=0
CONFIG_LOG_TAG_MAX_LEN=8

#Display configuration
# CONFIG_LV_Z_MEM_POOL_SIZE=16384
# CONFIG_LV_Z_SHELL=y
# CONFIG_MAIN_STACK_SIZE=2048

# CONFIG_DISPLAY=y
# CONFIG_DISPLAY_LOG_LEVEL_ERR=y

# CONFIG_SHELL=y
# CONFIG_DISPLAY_ST7735R=y
# CONFIG_MIPI_DBI=y
# CONFIG_MIPI_DBI_SPI=y
# CONFIG_ST7735R=y
# CONFIG_LVGL=y
# CONFIG_LV_MEM_CUSTOM=y
# CONFIG_LV_USE_LOG=y
# CONFIG_LV_USE_LABEL=y
# CONFIG_LV_USE_BTN=y
# CONFIG_LV_USE_ARC=y
# CONFIG_LV_USE_IMG=y
# CONFIG_LV_USE_MONKEY=y
# CONFIG_LV_FONT_MONTSERRAT_14=y
# CONFIG_LV_COLOR_DEPTH_16=y
# CONFIG_ST7735R=y
# CONFIG_SPI=y
# CONFIG_DISPLAY_INIT_PRIORITY=90
# CONFIG_DISPLAY_LOG_LEVEL_DBG=y

#NVS requirements
CONFIG_NVS=y
CONFIG_FLASH=y
CONFIG_FLASH_MAP=y
CONFIG_FILE_SYSTEM=y

#DISABLE NFC
CONFIG_NFCT_PINS_AS_GPIOS=y

#nPM1300 requirements
CONFIG_SHELL=y
CONFIG_REGULATOR=y
CONFIG_SENSOR=y
```
